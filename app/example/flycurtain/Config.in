## app/example/flycurtain/Config.in
```kconfig
config AOS_APP_FLYCURTAIN
    bool "Fly Curtain Application"
    select AOS_COMP_CLI if !AOS_BOARD_ESP8266
    select AOS_COMP_NETMGR
    select AOS_COMP_OTA
    select AOS_COMP_CJSON
    select AOS_COMP_LINKKIT_SDK_C
    select APP_FEATURE_LINKKIT
    select AOS_COMP_CJSON
    help
        flycurtain

if AOS_APP_FLYCURTAIN
# Configurations for app flycurtain
choice
    prompt "Select Case"
    default FLYCURTAIN_CONFIG_CASE_SOLO
    help
        select case to build

    config FLYCURTAIN_CONFIG_CASE_SOLO
        bool "SOLO"
        help
            default case, build fly_curtain.c
endchoice

endif
```

## app/example/flydimming/Config.in
```kconfig
config AOS_APP_FLYDIMMING
    bool "Fly Dimming Application"
    select AOS_COMP_CLI if !AOS_BOARD_ESP8266
    select AOS_COMP_NETMGR
    select AOS_COMP_OTA
    select AOS_COMP_CJSON
    select AOS_COMP_LINKKIT_SDK_C
    select APP_FEATURE_LINKKIT
    select AOS_COMP_CJSON
    help
        fly dimming

if AOS_APP_FLYDIMMING
# Configurations for app flydimming
choice
    prompt "Select Case"
    default FLYDIMMING_CONFIG_CASE_SOLO
    help
        select case to build

    config FLYDIMMING_CONFIG_CASE_SOLO
        bool "SOLO"
        help
            default case, build fly_dimming.c
endchoice

endif
```

## app/example/flylight/Config.in
```kconfig
config AOS_APP_FLYLIGHT
    bool "Fly Light Application"
    select AOS_COMP_CLI if !AOS_BOARD_ESP8266
    select AOS_COMP_NETMGR
    select AOS_COMP_OTA
    select AOS_COMP_CJSON
    select AOS_COMP_LINKKIT_SDK_C
    select APP_FEATURE_LINKKIT
    select AOS_COMP_CJSON
    help
        flylight

if AOS_APP_FLYLIGHT
# Configurations for app flylight
choice
    prompt "Select Case"
    default FLYLIGHT_CONFIG_CASE_SOLO
    help
        select case to build

    config FLYLIGHT_CONFIG_CASE_SOLO
        bool "SOLO"
        help
            default case, build fly_light.c
endchoice

endif
```

## app/example/flyswitch/Config.in
```kconfig
config AOS_APP_FLYSWITCH
    bool "Fly Switch Application"
    select AOS_COMP_CLI if !AOS_BOARD_ESP8266
    select AOS_COMP_NETMGR
    select AOS_COMP_OTA
    select AOS_COMP_CJSON
    select AOS_COMP_LINKKIT_SDK_C
    select APP_FEATURE_LINKKIT
    select AOS_COMP_CJSON
    help
        flycurtain

if AOS_APP_FLYSWITCH
# Configurations for app flyswitch
choice
    prompt "Select Case"
    default FLYSWITCH_CONFIG_CASE_SOLO
    help
        select case to build

    config FLYSWITCH_CONFIG_CASE_SOLO
        bool "SOLO"
        help
            default case, build fly_switch.c
endchoice

endif
```
